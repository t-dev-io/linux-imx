## drivers/hms/3g/Kconfig
```kconfig
config HMS_PWR_3G
    tristate "HMS 3G power control driver" 
	default n
	help
	Say Y to get hms 3g power control.
```

## drivers/hms/Kconfig
```kconfig
menu "Hms Drivers"

source "drivers/hms/3g/Kconfig"
source "drivers/hms/wifi/Kconfig"

endmenu
```

## drivers/hms/wifi/Kconfig
```kconfig
config HMS_PWR_WIFI
    tristate "HMS WIFI power control driver" 
	default n
	help
	Say Y to get hms wifi power control.
```
